## boards/shields/charbdis_hw/Kconfig.defconfig
```kconfig
if SHIELD_CHARBDIS_HW_LEFT

config ZMK_KEYBOARD_NAME
    default "Charbdis HW"

config ZMK_SPLIT_ROLE_CENTRAL
    default y

endif # SHIELD_CHARBDIS_HW_LEFT

if SHIELD_CHARBDIS_HW_RIGHT

config ZMK_KEYBOARD_NAME
    default "Charbdis HW"

endif # SHIELD_CHARBDIS_HW_RIGHT

if SHIELD_CHARBDIS_HW_LEFT || SHIELD_CHARBDIS_HW_RIGHT

config ZMK_SPLIT
    default y

endif
```

## boards/shields/charbdis_hw/Kconfig.shield
```kconfig
config SHIELD_CHARBDIS_HW_LEFT
    def_bool $(shields_list_contains,charbdis_hw_left)

config SHIELD_CHARBDIS_HW_RIGHT
    def_bool $(shields_list_contains,charbdis_hw_right)
```
